## boards/infineon/cy8c4248lti_l475_custom/Kconfig.defconfig
```kconfig
# Copyright (c) 2025 PSoC 4200L Zephyr Port
# SPDX-License-Identifier: Apache-2.0

config BOARD_CY8C4248LTI_L475_CUSTOM
	select SOC_CY8C4248LTI_L475
```

## boards/infineon/cy8c4248lti_l475_custom/board.yml
```yaml
board:
  name: cy8c4248lti_l475_custom
  full_name: PSoC 4200L Custom Board (CY8C4248LTI-L475)
  vendor: infineon
  socs:
  - name: cy8c4248lti_l475
```

## boards/infineon/cy8c4248lti_l475_custom/cy8c4248lti_l475_custom_defconfig
```kconfig
# Copyright (c) 2025 PSoC 4200L Zephyr Port
# SPDX-License-Identifier: Apache-2.0

# Console
CONFIG_CONSOLE=y
CONFIG_UART_CONSOLE=y

# UART driver
CONFIG_SERIAL=y

# GPIO driver
CONFIG_GPIO=y

# Clock controller
CONFIG_CLOCK_CONTROL=y

# Note: Cortex-M0 vector table relocation is handled in soc.c
# via CPUSS_CONFIG.VECT_IN_RAM, not via CONFIG_SRAM_VECTOR_TABLE
```

## soc/infineon/psoc4/psoc4200l/Kconfig
```kconfig
# Copyright (c) 2025 PSoC 4200L Zephyr Port
# SPDX-License-Identifier: Apache-2.0

config SOC_PACKAGE_PSOC4200L_68_QFN
	bool

config SOC_SERIES_PSOC4200L
	select ARM
	select CPU_CORTEX_M0
	select BUILD_OUTPUT_HEX
	select BUILD_OUTPUT_BIN
	select DYNAMIC_INTERRUPTS
	select SOC_EARLY_INIT_HOOK
	select CPU_CORTEX_M_HAS_SYSTICK

config SOC_CY8C4248LTI_L475
	select SOC_PACKAGE_PSOC4200L_68_QFN
```

## soc/infineon/psoc4/psoc4200l/Kconfig.defconfig
```kconfig
# Copyright (c) 2025 PSoC 4200L Zephyr Port
# SPDX-License-Identifier: Apache-2.0

if SOC_SERIES_PSOC4200L

config NUM_IRQS
	default 32

config SYS_CLOCK_HW_CYCLES_PER_SEC
	default $(dt_node_int_prop_int,/cpus/cpu@0,clock-frequency)

endif # SOC_SERIES_PSOC4200L
```

## soc/infineon/psoc4/psoc4200l/Kconfig.soc
```kconfig
# Copyright (c) 2025 PSoC 4200L Zephyr Port
# SPDX-License-Identifier: Apache-2.0

# MCU series
config SOC_SERIES_PSOC4200L
	bool
	select SOC_FAMILY_INFINEON_PSOC4
	help
	  PSoC 4200L Series MCU (ARM Cortex-M0)

config SOC_SERIES
	default "psoc4200l" if SOC_SERIES_PSOC4200L

config SOC_CY8C4248LTI_L475
	bool
	select SOC_SERIES_PSOC4200L

config SOC
	default "cy8c4248lti_l475" if SOC_CY8C4248LTI_L475
```
